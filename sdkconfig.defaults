## sdkconfig.defaults
```kconfig
CONFIG_IDF_TARGET="esp32s3"
CONFIG_PARTITION_TABLE_CUSTOM=y
CONFIG_PARTITION_TABLE_CUSTOM_FILENAME="partitions/genesis_stage2_partitions.csv"
CONFIG_ESPTOOLPY_FLASHSIZE_16MB=y
CONFIG_FREERTOS_UNICORE=n
CONFIG_SPIRAM=y
CONFIG_SPIRAM_USE_MALLOC=y
CONFIG_ESP_WIFI_ENABLED=y
CONFIG_FATFS_CODEPAGE_437=y
CONFIG_FATFS_LFN_HEAP=y
CONFIG_LOG_DEFAULT_LEVEL_INFO=y
CONFIG_LVGL_DEFAULT_TASK_PRIORITY=5
CONFIG_LVGL_EVENT_DRIVER_INCLUDE="lvgl_indev.h"
```
